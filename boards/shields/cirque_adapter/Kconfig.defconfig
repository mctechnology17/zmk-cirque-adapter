## boards/shields/cirque_adapter/Kconfig.defconfig
```kconfig
if SHIELD_CIRQUE_ADAPTER_LEFT

config ZMK_SPLIT_ROLE_CENTRAL
    default y

config ZMK_POINTING
    default y

config I2C
	default y

endif

if SHIELD_CIRQUE_ADAPTER_LEFT || SHIELD_CIRQUE_ADAPTER_RIGHT

config ZMK_SPLIT
    default y

endif
```

## boards/shields/cirque_adapter/Kconfig.shield
```kconfig
# Copyright (c) 2022 The ZMK Contributors
# SPDX-License-Identifier: MIT

config SHIELD_CIRQUE_ADAPTER_LEFT
    def_bool $(shields_list_contains,cirque_adapter_left)

config SHIELD_CIRQUE_ADAPTER_RIGHT
    def_bool $(shields_list_contains,cirque_adapter_right)
```
