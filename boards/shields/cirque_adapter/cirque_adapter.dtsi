/*
 * Copyright (c) 2020 Pete Johanson
 *
 * SPDX-License-Identifier: MIT
 */

/ {
    glidepoint_listener: glidepoint_listener {
        compatible = "zmk,input-listener";
        status = "disabled";
        device = <&glidepoint>;
    };
};

&pro_micro_i2c {
    status = "okay";

    glidepoint: glidepoint@0 {
        compatible = "cirque,pinnacle";
        reg = <0x2a>;
        status = "okay";
        /* ZMK v0.4 (Zephyr 4.1) uses the Cirque Pinnacle driver of Zephyr, not the
         * cirque-input-module: the properties have new names and taps are opt in. */
        data-ready-gpios = <&pro_micro 1 (GPIO_ACTIVE_HIGH)>;
        sensitivity = "2x";
        sleep-mode-enable;
        primary-tap-enable;
    };
};
